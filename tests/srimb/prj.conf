## CMakeLists.txt
```
cmake_minimum_required(VERSION 3.20.0)
find_package(Zephyr REQUIRED HINTS $ENV{ZEPHYR_BASE})
project(srimb_tests)

# --- Header ---
target_include_directories(app PRIVATE
    ${CMAKE_CURRENT_SOURCE_DIR}/../../platform/infinity/SRIMB
    ${CMAKE_CURRENT_SOURCE_DIR}/../../platform/infinity/scheduler
    ${CMAKE_CURRENT_SOURCE_DIR}/../../lib
)

# --- Sorgenti (test + moduli) ---
file(GLOB test_sources
    ${CMAKE_CURRENT_SOURCE_DIR}/src/*.cpp
)
file(GLOB srimb_sources
    ${CMAKE_CURRENT_SOURCE_DIR}/../../platform/infinity/SRIMB/*.cpp
)
file(GLOB sched_sources
    ${CMAKE_CURRENT_SOURCE_DIR}/../../platform/infinity/scheduler/*.cpp
)
file(GLOB lib_sources
    ${CMAKE_CURRENT_SOURCE_DIR}/../../lib/*.cpp
)

target_sources(app PRIVATE
    ${test_sources}
    ${srimb_sources}
    ${sched_sources}
    ${lib_sources}
)
```

## prj.conf
```kconfig
# test/srimb_tests/prj.conf

CONFIG_ZTEST=y
CONFIG_CPP=y
CONFIG_STD_CPP17=y
CONFIG_CPP_EXCEPTIONS=n
CONFIG_CPP_RTTI=n
CONFIG_REQUIRES_FULL_LIBCPP=y 
# Se il tuo modulo usa il kernel o altre funzionalità:
CONFIG_MAIN_STACK_SIZE=2048
# Aggiungi qui eventuali CONFIG_ necessarie dal tuo modulo (es. CONFIG_SENSOR, CONFIG_EMUL)
CONFIG_LOG=y
CONFIG_LOG_MODE_IMMEDIATE=y
```

## src/test_manager.cpp
```c
// src/test_manager.cpp
#include "SRIMB.hpp"
#include <zephyr/ztest.h>
#include "SRIMBTopic.hpp"

struct MgrMetadata {
    using DataType = uint16_t;
    static constexpr const char* TOPIC_NAME = "mgr_topic";
    static constexpr uint32_t TOPIC_HASH = 0xDEAD;
};
using MgrTopic = srimb::SRIMBTopic<MgrMetadata>;

ZTEST_SUITE(srimb_manager_suite, NULL, NULL, NULL, NULL, NULL);

ZTEST(srimb_manager_suite, test_create_and_reuse)
{
    srimb::SRIMBTopicManager mgr;

    // Prima creazione per instance_id 1
    srimb::SRIMBTopicBase* base1 = mgr.getOrCreateTopic<MgrTopic>(1);
    zassert_not_null(base1);

    // Seconda chiamata con lo stesso ID deve restituire lo stesso puntatore
    srimb::SRIMBTopicBase* base1_again = mgr.getOrCreateTopic<MgrTopic>(1);
    zassert_equal_ptr(base1, base1_again, "Should return the same instance for same ID");
}

ZTEST(srimb_manager_suite, test_different_instances)
{
    srimb::SRIMBTopicManager mgr;

    srimb::SRIMBTopicBase* base1 = mgr.getOrCreateTopic<MgrTopic>(1);
    srimb::SRIMBTopicBase* base2 = mgr.getOrCreateTopic<MgrTopic>(2);

    zassert_not_equal(base1, base2, "Different IDs should yield different instances");
}
```

## src/test_queue_topic.cpp
```c
// src/test_queue_topic.cpp
#include <zephyr/ztest.h>
#include "SRIMBQueueTopic.hpp"

struct QueueMetadata {
    using DataType = uint32_t;
    static constexpr const char* TOPIC_NAME = "queue_topic";
    static constexpr uint32_t TOPIC_HASH = 0x5678;
    static constexpr uint8_t QUEUE_LENGTH = 4; // Coda corta per test di saturazione
};

using QueueTopic = srimb::SRIMBQueueTopic<QueueMetadata>;
using QueueSub = srimb::SRIMBSub<QueueTopic>;

ZTEST_SUITE(srimb_queue_suite, NULL, NULL, NULL, NULL, NULL);

ZTEST(srimb_queue_suite, test_queue_basic_pub_sub)
{
    QueueTopic topic;
    QueueSub sub(&topic);
    uint32_t out;

    topic.publish(100);
    zassert_true(sub.poll(out), "Poll should succeed");
    zassert_equal(out, 100);
}

ZTEST(srimb_queue_suite, test_queue_overwrite_oldest)
{
    QueueTopic topic;
    QueueSub sub(&topic);
    uint32_t out;

    // Riempiamo la coda (QUEUE_LENGTH = 4) e superiamola
    for (uint32_t i = 1; i <= 5; i++) {
        topic.publish(i);
    }

    // Ora la generazione più vecchia dovrebbe essere 2 (l'1 è stato sovrascritto)
    // Proviamo a leggere dal subscriber "vergine" (gen 0): dovrebbe segnalare missed
    zassert_true(sub.poll(out), "Poll should succeed");
    zassert_true(sub.get_missed(), "Missed flag should be set");
    // Il primo messaggio disponibile dovrebbe essere il 2
    zassert_equal(out, 2, "Should get the oldest available message");
}

ZTEST(srimb_queue_suite, test_queue_no_missed_when_caught_up)
{
    QueueTopic topic;
    QueueSub sub(&topic);
    uint32_t out;

    topic.publish(1);
    sub.poll(out); // ora sub è alla generazione 1

    topic.publish(2);
    topic.publish(3);
    sub.poll(out); // prende il 2
    sub.poll(out); // prende il 3

    zassert_false(sub.get_missed(), "Should not miss messages if polling fast enough");
}
```

## src/test_topic.cpp
```c
// src/test_topic.cpp
#include <zephyr/ztest.h>
#include "SRIMBTopic.hpp"
#include "SRIMBSub.hpp"
#include "SRIMBPub.hpp"

struct TestMetadata {
    using DataType = uint32_t;
    static constexpr const char* TOPIC_NAME = "test_topic";
    static constexpr uint32_t TOPIC_HASH = 0x1234;
};

using TestTopic = srimb::SRIMBTopic<TestMetadata>;
using TestSub = srimb::SRIMBSub<TestTopic>;
using TestPub = srimb::SRIMBPub<TestTopic>;

ZTEST_SUITE(srimb_topic_suite, NULL, NULL, NULL, NULL, NULL);

ZTEST(srimb_topic_suite, test_pub_sub_basic)
{
    TestTopic topic;
    TestSub sub(&topic);
    TestPub pub(&topic);
    uint32_t out = 0;

    // Poll iniziale: nessun dato
    zassert_false(sub.poll(out), "Poll should fail before any publish");

    // Pubblica e verifica
    zassert_true(pub.publish(42), "Publish should succeed");
    zassert_true(sub.updated(), "Subscriber should be updated");
    zassert_true(sub.poll(out), "Poll should succeed after publish");
    zassert_equal(out, 42, "Data mismatch");
}

ZTEST(srimb_topic_suite, test_generation_advances)
{
    TestTopic topic;
    TestSub sub(&topic);
    TestPub pub(&topic);
    uint32_t out;

    pub.publish(1);
    sub.poll(out);
    zassert_equal(sub.get_last_generation(), 1, "Generation should be 1");

    pub.publish(2);
    sub.poll(out);
    zassert_equal(sub.get_last_generation(), 2, "Generation should be 2");
}

ZTEST(srimb_topic_suite, test_subscriber_isolation)
{
    TestTopic topic;
    TestSub sub1(&topic);
    TestSub sub2(&topic);
    TestPub pub(&topic);
    uint32_t out1, out2;

    pub.publish(10);
    zassert_true(sub1.poll(out1), "Sub1 poll should succeed");
    zassert_true(sub2.poll(out2), "Sub2 poll should succeed");
    zassert_equal(out1, 10);
    zassert_equal(out2, 10);
}
```

## src/test_work_scheduling.cpp
```c
// src/test_work_scheduling.cpp
#include <zephyr/ztest.h>
#include "SRIMBWorkItemScheduling.hpp"
#include "SRIMBTopic.hpp"
#include "SRIMBSub.hpp"

// Mock di WorkItemBase per contare le esecuzioni
struct MockWorkItem : public WorkItemBase {
    int count{0};
    int submit()           override { count++; return 0; }
    int submitTo(WorkQueue&) override { count++; return 0; }
};

// Topic minimale per testare lo scheduling
struct SchedMetadata {
    using DataType = uint8_t;
    static constexpr const char* TOPIC_NAME = "sched_topic";
    static constexpr uint32_t TOPIC_HASH = 0xABCD;
};
using SchedTopic = srimb::SRIMBTopic<SchedMetadata>;
using SchedSub = srimb::SRIMBSub<SchedTopic>;

ZTEST_SUITE(srimb_scheduling_suite, NULL, NULL, NULL, NULL, NULL);

ZTEST(srimb_scheduling_suite, test_register_and_trigger)
{
    SchedTopic topic;
    SchedSub sub(&topic);
    MockWorkItem wi;

    zassert_true(sub.registerCallback(wi), "Registration should succeed");

    // Un publish deve triggerare il work item (required_updates di default = 1)
    topic.publish(1);
    zassert_equal(wi.count, 1, "Work item should run once");

    topic.publish(2);
    zassert_equal(wi.count, 2, "Work item should run again");
}

ZTEST(srimb_scheduling_suite, test_required_updates_batching)
{
    SchedTopic topic;
    SchedSub sub(&topic);
    MockWorkItem wi;

    sub.registerCallback(wi);
    // Impostiamo required_updates a 3
    zassert_true(topic.set_required_updates(sub, 3), "Setting required updates should succeed");

    topic.publish(1);
    zassert_equal(wi.count, 0, "Should not trigger yet (1/3)");

    topic.publish(2);
    zassert_equal(wi.count, 0, "Should not trigger yet (2/3)");

    topic.publish(3);
    zassert_equal(wi.count, 1, "Should trigger on 3rd publish");

    // Il contatore degli update deve essersi resettato
    topic.publish(4);
    zassert_equal(wi.count, 1, "Should not trigger immediately after reset");
}
```
