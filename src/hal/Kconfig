## src/hal/Kconfig
```kconfig
menuconfig HAL_ENABLED
	bool "Supporto HAL"
	default y



if HAL_ENABLED


menu "HAL settings"

config MAX_IMU_DEVICE
	int "Max number of imu device"
	range 0 8
	default 4

config DEVICE_NAME_MAX_LEN
	int "Max length of the device name"
	range 0 128
	default 64

endmenu

if TARGET_SITL
rsource "adapters/sitl/Kconfig"
endif

if TARGET_TEENSY41
rsource "adapters/hw/Kconfig"
endif

endif # ENABLE_BMI088
```

## src/hal/adapters/hw/imu/Kconfig
```kconfig
menu "IMU Drivers"

config IMU_SAMPLE_FREQUENCY
    int "Frequenza di campionamento dell'IMU (Hz)"
    range 1 2000
    default 500
    

rsource "bmi088/Kconfig"

rsource "icm42688p/Kconfig"
endmenu
```
