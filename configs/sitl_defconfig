## configs/sitl_defconfig
```kconfig
CONFIG_TARGET_SITL=y
# CONFIG_TARGET_TEENSY41 is not set
CONFIG_LOG_DEBUG=y
CONFIG_SENSOR_SIMULATED_VALUE=55
```

## configs/teensy41_defconfig
```kconfig
# CONFIG_TARGET_SITL is not set
CONFIG_TARGET_TEENSY41=y
CONFIG_LOG_DEBUG=n
# CONFIG_SENSOR_SIMULATED_VALUE non viene impostato perchè dipende da LOG_DEBUG
```

## src/drivers/hw/imu/Bmi088_driver/Kconfig
```kconfig
menuconfig BMI088_DRIVER_ENABLED
    bool "Supporto BMI088 driver"
    default y



if BMI088_DRIVER_ENABLED

config BMI088_NUM_INSTANCES
    int "Numero di sensori BMI088"
    range 1 3
    default 1

endif # ENABLE_BMI088
```

## src/drivers/hw/imu/ICM42688P_driver/Kconfig
```kconfig
menuconfig ICM42688P_DRIVER_ENABLED
    bool "Supporto ICM42688P driver"

if ICM42688P_DRIVER_ENABLED



menu "ICM42688P LPF settings"

config ICM42688P_ACCEL_LPF
    int "Accelerometer LPF cutoff frequency (Hz)"
    range 0 1000
    default 80

config ICM42688P_GYRO_LPF
    int "Gyroscope LPF cutoff frequency (Hz)"
    range 0 1000
    default 200

endmenu
endif # ENABLE_ICM42688P_DRIVER
```

## src/drivers/sitl/radio/Kconfig
```kconfig
menuconfig RADIO_SITL_DRIVER_ENABLED
    bool "Supporto BMI088 driver"
    default y



if RADIO_SITL_DRIVER_ENABLED

config RADIO_GCS_PORT
    int "Porta UDP sulla quale ascolta la ground control station."
    range 14000 16000
    default 14550





endif # RADIO_SITL_DRIVER_ENABLED
```

## src/hal/Kconfig
```kconfig
if TARGET_SITL
source "src/hal/SITL/Kconfig"
endif

if TARGET_TEENSY41
source "src/hal/teensy/Kconfig"
endif
```

## src/hal/teensy/Kconfig
```kconfig
source "src/hal/teensy/drivers/gps/Kconfig"
source "src/hal/teensy/drivers/imu/Kconfig"
```

## src/hal/teensy/drivers/gps/Bn280_driver/Kconfig
```kconfig
menuconfig BN280_DRIVER_ENABLED
    bool "Supporto BN280 driver"



if BN280_DRIVER_ENABLED

config BN280_NUM_INSTANCES
    int "Numero di GPS BN280 presenti sulla board"
    range 1 3
    default 1
    help
      Specifica quante istanze di GPS BN280 sono presenti sulla board.
      

#Instanza 0
config BN280_0_SERIAL
    int "BN280 0 Serial interface"
    range 0 3
    default 0
    depends on BN280_DRIVER_ENABLED && BN280_NUM_INSTANCES >= 1
    help
      Specifica l'interfaccia seriale utilizzata per il GPS BN280 0.


#Instanza 1
config BN280_1_SERIAL
    int "BN280 1 Serial interface"
    range 0 3
    default 1
    depends on BN280_DRIVER_ENABLED && BN280_NUM_INSTANCES >= 2
    help
      Specifica l'interfaccia seriale utilizzata per il GPS BN280 1.


#Instanza 2
config BN280_2_SERIAL
    int "BN280 2 Serial interface"
    range 0 3
    default 2
    depends on BN280_DRIVER_ENABLED && BN280_NUM_INSTANCES >= 3
    help
      Specifica l'interfaccia seriale utilizzata per il GPS BN280 2.


endif
```

## src/hal/teensy/drivers/gps/Kconfig
```kconfig
menu "GPS Drivers"
source "src/hal/teensy/drivers/gps/Bn280_driver/Kconfig"
endmenu
```

## src/hal/teensy/drivers/imu/Bmi088_driver/Kconfig
```kconfig
menuconfig BMI088_DRIVER_ENABLED
    bool "Supporto BMI088 driver"



if BMI088_DRIVER_ENABLED

config BMI088_NUM_INSTANCES
    int "Numero di sensori BMI088"
    range 1 3
    default 1

# Istanza 0
if BMI088_NUM_INSTANCES >= 1

choice
    prompt "Protocollo per BMI088 #0"
    default BMI088_0_I2C

config BMI088_0_I2C
    bool "I2C"

config BMI088_0_SPI
    bool "SPI"

endchoice

config BMI088_0_I2C_ADDR
    hex "Indirizzo I2C per BMI088 #0"
    depends on BMI088_0_I2C
    default 0x68
    range 0x00 0x7F

config BMI088_0_SPI_CS
    int "Pin CS per BMI088 #0"
    depends on BMI088_0_SPI
    default 10
    range 0 31

endif # BMI088_NUM_INSTANCES >= 1

# Istanza 1 (se abilitata)
if BMI088_NUM_INSTANCES >= 2

choice
    prompt "Protocollo per BMI088 #1"
    default BMI088_1_I2C

config BMI088_1_I2C
    bool "I2C"

config BMI088_1_SPI
    bool "SPI"

endchoice

config BMI088_1_I2C_ADDR
    hex "Indirizzo I2C per BMI088 #1"
    depends on BMI088_1_I2C
    default 0x69
    range 0x00 0x7F

config BMI088_1_SPI_CS
    int "Pin CS per BMI088 #1"
    depends on BMI088_1_SPI
    default 11
    range 0 31

endif # BMI088_NUM_INSTANCES >= 2

# Istanza 2 (se abilitata)
if BMI088_NUM_INSTANCES >= 3

choice
    prompt "Protocollo per BMI088 #2"
    default BMI088_2_I2C

config BMI088_2_I2C
    bool "I2C"

config BMI088_2_SPI
    bool "SPI"

endchoice

config BMI088_2_I2C_ADDR
    hex "Indirizzo I2C per BMI088 #2"
    depends on BMI088_2_I2C
    default 0x6A
    range 0x00 0x7F

config BMI088_2_SPI_CS
    int "Pin CS per BMI088 #2"
    depends on BMI088_2_SPI
    default 11
    range 0 31

endif # BMI088_NUM_INSTANCES >= 2

endif # ENABLE_BMI088
```

## src/hal/teensy/drivers/imu/Kconfig
```kconfig
menu "IMU Drivers"
source "../src/hal/teensy/drivers/imu/Bmi088_driver/Kconfig"

source "../src/hal/teensy/drivers/imu/ICM42688P_driver/Kconfig"
endmenu
```

## src/modules/Logger/Kconfig
```kconfig
menu "Logger module configuration"



config LOGGER_ENABLED
    bool "Enable Logger Module"
    default y

config LOG_IMU_ENABLED
    bool "Enable log messages on IMU topics"
    default y
    depends on LOGGER_ENABLED

config LOG_GPS_ENABLED
    bool "Enable log messages on GPS topics"
    default y
    depends on LOGGER_ENABLED

config LOG_MAG_ENABLED
    bool "Enable log messages on Magnetometer topics"
    default y
    depends on LOGGER_ENABLED

config LOG_BARO_ENABLED
    bool "Enable log messages on Barometer topics"
    default y
    depends on LOGGER_ENABLED

config LOG_LIDAR_ENABLED
    bool "Enable log messages on Lidar topics"
    default y
    depends on LOGGER_ENABLED

config LOG_EKF_ENABLED
    bool "Enable log messages on EKF topics"
    default y
    depends on LOGGER_ENABLED

config LOG_SYS_INFO_ENABLED
    bool "Enable log messages on System General Information topics"
    default y
    depends on LOGGER_ENABLED
endmenu
```

## src/modules/logger/Kconfig
```kconfig
menuconfig LOGGER_ENABLED
    bool "Logger module configuration"
    default y



if LOGGER_ENABLED

config LOG_IMU_ENABLED
    bool "Enable log messages on IMU topics"
    default y
    depends on LOGGER_ENABLED

config LOG_GPS_ENABLED
    bool "Enable log messages on GPS topics"
    default y
    depends on LOGGER_ENABLED

config LOG_MAG_ENABLED
    bool "Enable log messages on Magnetometer topics"
    default y
    depends on LOGGER_ENABLED

config LOG_BARO_ENABLED
    bool "Enable log messages on Barometer topics"
    default y
    depends on LOGGER_ENABLED

config LOG_LIDAR_ENABLED
    bool "Enable log messages on Lidar topics"
    default y
    depends on LOGGER_ENABLED

config LOG_EKF_ENABLED
    bool "Enable log messages on EKF topics"
    default y
    depends on LOGGER_ENABLED

config LOG_SYS_INFO_ENABLED
    bool "Enable log messages on System General Information topics"
    default y
    depends on LOGGER_ENABLED

config LOGGER_BUFFER_SIZE
    int "Dimensione del buffer circolare per i messaggi di log in KB"
    range 8 64
    default 32
    depends on LOGGER_ENABLED
    help
      Specifica la dimensione del buffer circolare per i messaggi di log in KB.

endif # LOGGER_ENABLED
```

## src/scheduler/Kconfig
```kconfig
menu "Scheduler settings"

config MAX_TASKS
    int "Maximum number of task that can be scheduled"
    range 1 16
    default 16

endmenu 
```
